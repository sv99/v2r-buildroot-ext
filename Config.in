## Config.in
```kconfig
# Virt2real additional packages
source "$BR2_EXTERNAL/package/virt2real/Config.in"

source "$BR2_EXTERNAL/package/babeld/Config.in"
source "$BR2_EXTERNAL/package/dejavu-fonts/Config.in"
source "$BR2_EXTERNAL/package/gphoto2/Config.in"
source "$BR2_EXTERNAL/package/gphotofs/Config.in"
source "$BR2_EXTERNAL/package/libgphoto2/Config.in"
source "$BR2_EXTERNAL/package/linuxconsoletools/Config.in"
source "$BR2_EXTERNAL/package/ltwheelconf/Config.in"
source "$BR2_EXTERNAL/package/miniupnp/Config.in"
source "$BR2_EXTERNAL/package/miniupnpc/Config.in"
source "$BR2_EXTERNAL/package/miredo/Config.in"
source "$BR2_EXTERNAL/package/nanomsg/Config.in"
source "$BR2_EXTERNAL/package/pjsip/Config.in"
source "$BR2_EXTERNAL/package/pwnat/Config.in"
source "$BR2_EXTERNAL/package/rfkill/Config.in"
source "$BR2_EXTERNAL/package/uaputl/Config.in"
source "$BR2_EXTERNAL/package/zbar/Config.in"

# multimedia

menu "V2R Audio and video applications"
	source "$BR2_EXTERNAL/package/festival/Config.in"
	source "$BR2_EXTERNAL/package/gst-rtsp-server/Config.in"
	source "$BR2_EXTERNAL/package/gst-ti-dmai/Config.in"
	source "$BR2_EXTERNAL/package/gst-usb/Config.in"
	source "$BR2_EXTERNAL/package/gstd/Config.in"
	source "$BR2_EXTERNAL/package/pocketsphinx/Config.in"
	source "$BR2_EXTERNAL/package/sphinxbase/Config.in"
	source "$BR2_EXTERNAL/package/v4l2grab/Config.in"
endmenu
```

## package/gst-pipeapp/Config.in
```kconfig
config BR2_PACKAGE_GST_PIPEAPP
	bool "gst-pipeapp"
	select BR2_PACKAGE_GSTREAMER
	help
	 Library and test application for gstreamer appsink new-buffer callback.
	 
	 https://github.com/sv99/gst-pipeapp
```

## package/gst-videoratedivider010/Config.in
```kconfig
config BR2_PACKAGE_GST_VIDEORATEDIVIDER010
	bool "gst-vidoratedivider010"
	select BR2_PACKAGE_GSTREAMER
	help
	 Simple GStreamer plugin for stream downsampling.
	 
	 https://github.com/sv99/gst-videoratedivider010
```

## package/node-gstreamer010-superficial/Config.in
```kconfig
config BR2_PACKAGE_NODE_GSTREAMER010_SUPERFICIAL
	bool "node-gstreamer010-superficial"
	depends on BR2_PACKAGE_NODEJS
	depends on BR2_PACKAGE_GSTREAMER
	help
	  Backport Node.JS Superficial GStreamer binding to gstreamer-0.10.

	  https://github.com/sv99/node-gstreamer010-superficial
```

## package/perl-carp/Config.in
```kconfig
config BR2_PACKAGE_PERL_CARP
	bool "perl-carp"
	help
	  alternative warn and die for modules

	  https://metacpan.org/release/Carp
```

## package/perl-data-dumper/Config.in
```kconfig
config BR2_PACKAGE_PERL_DATA_DUMPER
	bool "perl-data-dumper"
	depends on !BR2_STATIC_LIBS
	help
	  stringified perl data structures, suitable for both printing and eval

	  https://metacpan.org/release/Data-Dumper

comment "perl-data-dumper needs a toolchain w/ dynamic library"
	depends on BR2_STATIC_LIBS
```

## package/perl-device-i2c-adv7611/Config.in
```kconfig
config BR2_PACKAGE_PERL_DEVICE_I2C_ADV7611
	bool "perl-device-i2c-adv7611"
	depends on !BR2_STATIC_LIBS
	select BR2_PACKAGE_PERL_DEVICE_I2C
	help
	  I2C interface to ADV7611 using Device::I2C

	  https://metacpan.org/release/Device-I2C-ADV7611

comment "perl-device-i2c-adv7611 needs a toolchain w/ dynamic library"
	depends on BR2_STATIC_LIBS
```

## package/perl-device-i2c/Config.in
```kconfig
config BR2_PACKAGE_PERL_DEVICE_I2C
	bool "perl-device-i2c"
	depends on !BR2_STATIC_LIBS
	help
	  Control and read hardware devices with i2c(SMBus)

	  https://metacpan.org/release/Device-I2C

comment "perl-device-i2c needs a toolchain w/ dynamic library"
	depends on BR2_STATIC_LIBS
```

## package/perl-device-smbus/Config.in
```kconfig
config BR2_PACKAGE_PERL_DEVICE_SMBUS
	bool "perl-device-smbus"
	depends on !BR2_STATIC_LIBS
	select BR2_PACKAGE_PERL_MOO
	help
	  Control and read hardware devices with i2c(SMBus)

	  https://metacpan.org/release/Device-SMBus

comment "perl-device-smbus needs a toolchain w/ dynamic library"
	depends on BR2_STATIC_LIBS
```

## package/perl-moo/Config.in
```kconfig
config BR2_PACKAGE_PERL_MOO
	bool "perl-moo"
	help
	  Minimalist Object Orientation (with Moose compatibility)

	  https://metacpan.org/release/Moo
```

## package/perl-sub-exporter-progressive/Config.in
```kconfig
config BR2_PACKAGE_PERL_SUB_EXPORTER_PROGRESSIVE
	bool "perl-sub-exporter-progressive"
	help
	  Only use Sub::Exporter if you need it

	  http://search.cpan.org/dist/Sub-Exporter-Progressive/
```

## package/python-backports-abc/Config.in
```kconfig
config BR2_PACKAGE_PYTHON_BACPORTS_ABC
	bool "python-backports-abc"
	depends on BR2_PACKAGE_PYTHON
	help
	  A backport of recent additions to the 'collections.abc'
	  module.

	  https://pypi.python.org/pypi/backports_abc
```

## package/python-future/Config.in
```kconfig
config BR2_PACKAGE_PYTHON_FUTURE
	bool "python-future"
	depends on BR2_PACKAGE_PYTHON
	help
	  Clean single-source support for Python 3 and 2

	  future is the missing compatibility layer between Python 2
	  and Python 3. It allows you to use a single, clean 
	  Python 3.x-compatible codebase to support both Python 2 and
	  Python 3 with minimal overhead.

	  https://pypi.python.org/pypi/future
```

## package/python-futures/Config.in
```kconfig
config BR2_PACKAGE_PYTHON_FUTURES
	bool "python-futures"
	depends on BR2_PACKAGE_PYTHON
	help
	  Backport of the concurrent.futures package from Python 3.2

	  https://pypi.python.org/pypi/future
```

## package/python-sqlalchemy/Config.in
```kconfig
config BR2_PACKAGE_PYTHON_SQLALCHEMY
	bool "python-sqlalchemy"
	depends on BR2_PACKAGE_PYTHON
	help
	  Database Abstraction Library

	  The Python SQL Toolkit and Object Relational Mapper

	  https://pypi.python.org/pypi/sqlalchemy
```

## package/v2r-irsend/Config.in
```kconfig
config BR2_PACKAGE_V2R_IRSEND
	bool "v2r-irsend"
	select BR2_PACKAGE_V2R_IRSEND
	help
	 Send ir command with pulse data from command line.
	 
	 https://github.com/sv99/v2r-irsend
```

## package/virt2real/Config.in
```kconfig
menu "Virt2real additional packages"
source "$BR2_EXTERNAL/package/virt2real/speech/Config.in"
source "$BR2_EXTERNAL/package/virt2real/nodejs_modules/Config.in"
source "$BR2_EXTERNAL/package/virt2real/teleguejs/Config.in"
source "$BR2_EXTERNAL/package/virt2real/gpio-event/Config.in"
source "$BR2_EXTERNAL/package/virt2real/rtsp-server/Config.in"
source "$BR2_EXTERNAL/package/virt2real/rcboard/Config.in"
source "$BR2_EXTERNAL/package/virt2real/i2c_write/Config.in"
source "$BR2_EXTERNAL/package/virt2real/uflash/Config.in"
endmenu
```
